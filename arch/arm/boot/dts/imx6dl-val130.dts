/*
 * Copyright (C) 2015 Access-IS
 * Based on work by Solid Run & Russell King
 */
/dts-v1/;

#include "imx6dl.dtsi"
#include "imx6qdl-val130.dtsi"

/ {
	model = "Access-IS VAL130 Solo/DualLite";
	compatible = "Access-IS,val130/dl", "fsl,imx6dl";
};
